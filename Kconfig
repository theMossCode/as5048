## drivers/as5048a/Kconfig
```kconfig
menuconfig AS5048A
    bool "AS5048A magnetic rotary encode"
    depends on SPI
    help
      Enable driver for AS5048A using SPI
```

## dts/bindings/ams,as5048a.yaml
```yaml
description:
  Device driver binding for the AMS AS4058A magnetic rotary encoder

compatible: "ams,as5048a"

include: spi-device.yaml
```

## example/build/Kconfig/Kconfig.shield
```kconfig
osource "d:/Misc/AS5048/Code/as5048/example/boards/shields/*/Kconfig.shield"
osource "C:/ncs/v2.0.0/nrf/boards/shields/*/Kconfig.shield"
```

## example/build/Kconfig/Kconfig.shield.defconfig
```kconfig
osource "d:/Misc/AS5048/Code/as5048/example/boards/shields/*/Kconfig.defconfig"
osource "C:/ncs/v2.0.0/nrf/boards/shields/*/Kconfig.defconfig"
```
